## Config.in
```kconfig
# make the variant name available as a Config.in variable
#
# you can use BR2SM_PROJECT_NAME to have some options only appear for some variants
#
config BR2SM_PROJECT_NAME
	string
	option env="PROJECT_NAME"

source "$BR2_EXTERNAL_BUILDROOT_SUBMODULE_PATH/package/yio-remote/Config.in"
source "$BR2_EXTERNAL_BUILDROOT_SUBMODULE_PATH/package/qtmqtt/Config.in"
```

## buildroot-external/Config.in
```kconfig
source "$BR2_EXTERNAL_YIOS_PATH/package/yio-remote/Config.in"
source "$BR2_EXTERNAL_YIOS_PATH/package/yio-wiringpi/Config.in"
source "$BR2_EXTERNAL_YIOS_PATH/package/qtmqtt/Config.in"
```

## buildroot-external/configs/rpi0w_defconfig
```kconfig
BR2_arm=y
BR2_arm1176jzf_s=y
BR2_DL_DIR="$(HOME)/buildroot/dl"
BR2_GNU_MIRROR="http://ftp.thunix.net/gnu-ftp"
BR2_CCACHE=y
BR2_CCACHE_DIR="$(HOME)/buildroot/ccache"
BR2_OPTIMIZE_2=y
BR2_PACKAGE_OVERRIDE_FILE="$(BR2_EXTERNAL_YIOS_PATH)/local.mk"
BR2_GLOBAL_PATCH_DIR="$(BR2_EXTERNAL_YIOS_PATH)/patches $(BR2_EXTERNAL_YIOS_PATH)/board/raspberrypi/patches"
BR2_SSP_REGULAR=y
BR2_TOOLCHAIN_BUILDROOT_GLIBC=y
BR2_PACKAGE_HOST_LINUX_HEADERS_CUSTOM_4_19=y
BR2_GCC_VERSION_9_X=y
BR2_TOOLCHAIN_BUILDROOT_CXX=y
BR2_GCC_ENABLE_LTO=y
BR2_TARGET_GENERIC_HOSTNAME="yio-dev"
BR2_TARGET_GENERIC_ISSUE="Welcome to YIO Developer Edition"
BR2_INIT_SYSTEMD=y
BR2_TARGET_GENERIC_ROOT_PASSWD="yioremote"
BR2_TARGET_GENERIC_GETTY_PORT="tty1"
BR2_ROOTFS_OVERLAY="$(BR2_EXTERNAL_YIOS_PATH)/rootfs-overlay $(BR2_EXTERNAL_YIOS_PATH)/board/raspberrypi/rootfs-overlay"
BR2_ROOTFS_POST_BUILD_SCRIPT="$(BR2_EXTERNAL_YIOS_PATH)/scripts/post-build.sh"
BR2_ROOTFS_POST_IMAGE_SCRIPT="$(BR2_EXTERNAL_YIOS_PATH)/scripts/post-image.sh"
BR2_ROOTFS_POST_SCRIPT_ARGS="$(BR2_EXTERNAL_YIOS_PATH)/board/raspberrypi/rpi0w $(BR2_EXTERNAL_YIOS_PATH)/board/raspberrypi/build-hook.sh"
BR2_LINUX_KERNEL=y
BR2_LINUX_KERNEL_CUSTOM_TARBALL=y
BR2_LINUX_KERNEL_CUSTOM_TARBALL_LOCATION="https://github.com/raspberrypi/linux/archive/cc39f1c9f82f6fe5a437836811d906c709e0661c.tar.gz"
BR2_LINUX_KERNEL_DEFCONFIG="bcmrpi"
BR2_LINUX_KERNEL_CONFIG_FRAGMENT_FILES="$(BR2_EXTERNAL_YIOS_PATH)/kernel/yio-dev.config $(BR2_EXTERNAL_YIOS_PATH)/kernel/container.config $(BR2_EXTERNAL_YIOS_PATH)/kernel/device-support.config $(BR2_EXTERNAL_YIOS_PATH)/kernel/device-support-dev.config $(BR2_EXTERNAL_YIOS_PATH)/board/raspberrypi/kernel.config"
BR2_LINUX_KERNEL_LZ4=y
BR2_LINUX_KERNEL_DTS_SUPPORT=y
BR2_LINUX_KERNEL_INTREE_DTS_NAME="bcm2708-rpi-zero-w"
BR2_LINUX_KERNEL_NEEDS_HOST_OPENSSL=y
BR2_LINUX_KERNEL_NEEDS_HOST_LIBELF=y
BR2_PACKAGE_FFMPEG=y
BR2_PACKAGE_LZ4=y
BR2_PACKAGE_JQ=y
BR2_PACKAGE_E2FSPROGS=y
BR2_PACKAGE_E2FSPROGS_RESIZE2FS=y
BR2_PACKAGE_SQUASHFS=y
BR2_PACKAGE_SQUASHFS_LZO=y
BR2_PACKAGE_LIBERATION=y
BR2_PACKAGE_QT5CINEX=y
BR2_PACKAGE_QT5CINEX_HD=y
BR2_PACKAGE_FBV=y
BR2_PACKAGE_QT5=y
BR2_PACKAGE_QT5BASE_DEFAULT_QPA="eglfs"
BR2_PACKAGE_QT5TOOLS_QTPLUGININFO=y
BR2_PACKAGE_RPI_BT_FIRMWARE=y
BR2_PACKAGE_RPI_FIRMWARE=y
BR2_PACKAGE_RPI_WIFI_FIRMWARE=y
BR2_PACKAGE_DBUS_CPP=y
BR2_PACKAGE_I2C_TOOLS=y
BR2_PACKAGE_LIBUBOOTENV=y
BR2_PACKAGE_RNG_TOOLS=y
BR2_PACKAGE_RPI_USERLAND=y
BR2_PACKAGE_NODEJS=y
BR2_PACKAGE_NODEJS_NPM=y
BR2_PACKAGE_OPUS=y
BR2_PACKAGE_LIBARCHIVE=y
BR2_PACKAGE_LIBZIP=y
BR2_PACKAGE_CA_CERTIFICATES=y
BR2_PACKAGE_GNUTLS=y
BR2_PACKAGE_LIBNSS=y
BR2_PACKAGE_LIBOPENSSL_ENGINES=y
BR2_PACKAGE_LIBCONFIG=y
BR2_PACKAGE_LIBDRM=y
BR2_PACKAGE_TIFF=y
BR2_PACKAGE_WEBP=y
BR2_PACKAGE_WEBP_DEMUX=y
BR2_PACKAGE_LIBGPIOD=y
BR2_PACKAGE_LIBGPIOD_TOOLS=y
BR2_PACKAGE_JSON_C=y
BR2_PACKAGE_LIBXML2=y
BR2_PACKAGE_LIBVPX=y
BR2_PACKAGE_GLIB_NETWORKING=y
BR2_PACKAGE_LIBCGI=y
BR2_PACKAGE_LIBCURL=y
BR2_PACKAGE_LIBCURL_CURL=y
BR2_PACKAGE_LIBCURL_GNUTLS=y
BR2_PACKAGE_LIBEVDEV=y
BR2_PACKAGE_AVAHI=y
# BR2_PACKAGE_AVAHI_AUTOIPD is not set
BR2_PACKAGE_AVAHI_DAEMON=y
BR2_PACKAGE_AVAHI_LIBDNSSD_COMPATIBILITY=y
BR2_PACKAGE_BIND=y
BR2_PACKAGE_BLUEZ_TOOLS=y
BR2_PACKAGE_BLUEZ5_UTILS=y
BR2_PACKAGE_BLUEZ5_UTILS_CLIENT=y
BR2_PACKAGE_BLUEZ5_UTILS_DEPRECATED=y
BR2_PACKAGE_BLUEZ5_UTILS_TEST=y
BR2_PACKAGE_CRDA=y
BR2_PACKAGE_DHCPCD=y
BR2_PACKAGE_DROPBEAR=y
BR2_PACKAGE_GESFTPSERVER=y
BR2_PACKAGE_IPTABLES=y
BR2_PACKAGE_IW=y
BR2_PACKAGE_LIGHTTPD=y
BR2_PACKAGE_LIGHTTPD_PCRE=y
BR2_PACKAGE_NTP=y
# BR2_PACKAGE_NTP_NTPD is not set
BR2_PACKAGE_WPA_SUPPLICANT=y
BR2_PACKAGE_WPA_SUPPLICANT_AP_SUPPORT=y
BR2_PACKAGE_WPA_SUPPLICANT_WIFI_DISPLAY=y
BR2_PACKAGE_WPA_SUPPLICANT_AUTOSCAN=y
BR2_PACKAGE_WPA_SUPPLICANT_EAP=y
BR2_PACKAGE_WPA_SUPPLICANT_WPS=y
BR2_PACKAGE_WPA_SUPPLICANT_WPA3=y
BR2_PACKAGE_WPA_SUPPLICANT_CLI=y
BR2_PACKAGE_WPA_SUPPLICANT_WPA_CLIENT_SO=y
BR2_PACKAGE_WPA_SUPPLICANT_PASSPHRASE=y
BR2_PACKAGE_BASH=y
BR2_PACKAGE_SWUPDATE=y
BR2_PACKAGE_SWUPDATE_CONFIG="$(BR2_EXTERNAL_YIOS_PATH)/board/raspberrypi/swupdate.config"
BR2_PACKAGE_SWUPDATE_INSTALL_CLIENT_TOOLS=y
BR2_PACKAGE_SWUPDATE_INSTALL_HAWKBIT_TOOLS=y
# BR2_PACKAGE_SYSTEMD_HWDB is not set
# BR2_PACKAGE_SYSTEMD_MYHOSTNAME is not set
BR2_PACKAGE_UTIL_LINUX_KILL=y
BR2_PACKAGE_NANO=y
#BR2_TARGET_ROOTFS_EXT2=y
#BR2_TARGET_ROOTFS_EXT2_4=y
#BR2_TARGET_ROOTFS_EXT2_SIZE="1024M"
#BR2_TARGET_ROOTFS_EXT2_MKFS_OPTIONS="-O 64bit -L 'YIO RPi0 root'"
BR2_TARGET_ROOTFS_SQUASHFS=y
BR2_TARGET_ROOTFS_SQUASHFS4_LZO=y
# BR2_TARGET_ROOTFS_TAR is not set
BR2_TARGET_UBOOT=y
BR2_TARGET_UBOOT_BUILD_SYSTEM_KCONFIG=y
BR2_TARGET_UBOOT_CUSTOM_VERSION=y
BR2_TARGET_UBOOT_CUSTOM_VERSION_VALUE="2020.10"
BR2_TARGET_UBOOT_BOARD_DEFCONFIG="rpi_0_w"
BR2_TARGET_UBOOT_CONFIG_FRAGMENT_FILES="$(BR2_EXTERNAL_YIOS_PATH)/board/raspberrypi/uboot.config"
BR2_TARGET_UBOOT_BOOT_SCRIPT=y
BR2_TARGET_UBOOT_BOOT_SCRIPT_SOURCE="$(BR2_EXTERNAL_YIOS_PATH)/board/raspberrypi/uboot-boot.ush"
BR2_PACKAGE_HOST_DOSFSTOOLS=y
BR2_PACKAGE_HOST_GENEXT2FS=y
BR2_PACKAGE_HOST_GENIMAGE=y
BR2_PACKAGE_HOST_MTOOLS=y
BR2_PACKAGE_HOST_SQUASHFS=y
BR2_PACKAGE_HOST_UBOOT_TOOLS=y
BR2_PACKAGE_HOST_ZIP=y
BR2_PACKAGE_YIO_REMOTE=y
BR2_PACKAGE_YIO_INTEGRATION_OPENHAB=y
BR2_PACKAGE_QTMQTT=y
```

## buildroot-external/package/yio-remote/Config.in
```kconfig
menuconfig BR2_PACKAGE_YIO_REMOTE
	bool "YIO remote"
	depends on BR2_PACKAGE_QT5
	select BR2_PACKAGE_QT5TOOLS
	select BR2_PACKAGE_QT5TOOLS_LINGUIST_TOOLS
	select BR2_PACKAGE_QT5BASE_OPENGL_LIB
	select BR2_PACKAGE_QT5BASE_EGLFS
	select BR2_PACKAGE_QT5BASE_FONTCONFIG
	select BR2_PACKAGE_QT5BASE_GIF
	select BR2_PACKAGE_QT5BASE_JPEG
	select BR2_PACKAGE_QT5BASE_PNG
	select BR2_PACKAGE_QT5BASE_ICU
	select BR2_PACKAGE_QT5BASE_TSLIB
	select BR2_PACKAGE_QT5CONNECTIVITY
	select BR2_PACKAGE_QT5GRAPHICALEFFECTS
	select BR2_PACKAGE_QT5IMAGEFORMATS
	select BR2_PACKAGE_QT5QUICKCONTROLS
	select BR2_PACKAGE_QT5QUICKCONTROLS2
	select BR2_PACKAGE_QT5VIRTUALKEYBOARD
	select BR2_PACKAGE_QT5VIRTUALKEYBOARD_HANDWRITING
	select BR2_PACKAGE_QT5WEBSOCKETS
	select BR2_PACKAGE_YIO_INTEGRATIONS_LIBRARY
	help
	  YIO Remote software package. Sub-options allow to customize the
	  installation.
	  For more information see: https://github.com/YIO-Remote

if BR2_PACKAGE_YIO_REMOTE

# Default versions of all YIO components which work together in this remote-os release.
# All YIO components have their own release channel and version numbers don't relate or indicate a compatible version!
config BR2_PACKAGE_YIO_REMOTE_SOFTWARE_VERSION_DEF
	string
	default "v0.7.0"
config BR2_PACKAGE_YIO_INTEGRATIONS_LIBRARY_VERSION_DEF
	string
	default "v0.5.3"
config BR2_PACKAGE_YIO_WEB_CONFIGURATOR_VERSION_DEF
	string
	default "v0.2.1"
config BR2_PACKAGE_YIO_INTEGRATION_DOCK_VERSION_DEF
	string
	default "v0.6.4"
config BR2_PACKAGE_YIO_INTEGRATION_HOMEASSISTANT_VERSION_DEF
	string
	default "v0.5.7"
config BR2_PACKAGE_YIO_INTEGRATION_HOMEY_VERSION_DEF
	string
	default "v0.5.4"
config BR2_PACKAGE_YIO_INTEGRATION_OPENHAB_VERSION_DEF
	string
	default "v0.5.4"
config BR2_PACKAGE_YIO_INTEGRATION_SPOTIFY_VERSION_DEF
	string
	default "v0.5.4"
config BR2_PACKAGE_YIO_INTEGRATION_BANGOLUFSEN_VERSION_DEF
	string
	default "v0.2.5"
config BR2_PACKAGE_YIO_INTEGRATION_OPENWEATHER_VERSION_DEF
	string
	default "v0.5.4"
config BR2_PACKAGE_YIO_INTEGRATION_ROON_VERSION_DEF
	string
	default "v0.4.4"

config BR2_PACKAGE_YIO_REMOTE_DEBUG
	bool "Debug build"
	help
	  Build or install the debug version of the Qt based YIO application and
	  integration plugins.
	  Attention: Buildroot will cache the build folder after the first build.
	  To switch between debug an release builds afterwards, all involved
	  packages must be reconfigured by executing:
	  make yio-${PACKAGE_NAME}-reconfigure
	  or the build directories of all yio packages must be deleted:
	  rm -Rf rpi0/output/build/yio-*
	  before building a new image!

config BR2_PACKAGE_YIO_REMOTE_CUSTOM_VERSION
	bool "Custom versions (DANGEROUS!)"
	help
	  Allow to specify custom versions of the application and integration
	  plugins.
	  Attention: using custom versions might break compatability between the
	  remote application and the integration plugins!

source "$BR2_EXTERNAL_YIOS_PATH/package/yio-remote/yio-remote-software/Config.in"
source "$BR2_EXTERNAL_YIOS_PATH/package/yio-remote/yio-integrations-library/Config.in"
source "$BR2_EXTERNAL_YIOS_PATH/package/yio-remote/yio-web-configurator/Config.in"

config BR2_PACKAGE_YIO_REMOTE_INTEGRATIONS
	bool "Integration plugins"
	default y
	help
	  Include YIO integration plugins.

source "$BR2_EXTERNAL_YIOS_PATH/package/yio-remote/yio-integration-dock/Config.in"
source "$BR2_EXTERNAL_YIOS_PATH/package/yio-remote/yio-integration-homeassistant/Config.in"
source "$BR2_EXTERNAL_YIOS_PATH/package/yio-remote/yio-integration-homey/Config.in"
source "$BR2_EXTERNAL_YIOS_PATH/package/yio-remote/yio-integration-spotify/Config.in"
source "$BR2_EXTERNAL_YIOS_PATH/package/yio-remote/yio-integration-bangolufsen/Config.in"
source "$BR2_EXTERNAL_YIOS_PATH/package/yio-remote/yio-integration-openhab/Config.in"
source "$BR2_EXTERNAL_YIOS_PATH/package/yio-remote/yio-integration-roon/Config.in"
source "$BR2_EXTERNAL_YIOS_PATH/package/yio-remote/yio-integration-openweather/Config.in"

endif # BR2_PACKAGE_YIO_REMOTE
```

## buildroot-external/package/yio-remote/yio-integration-bangolufsen/Config.in
```kconfig
if BR2_PACKAGE_YIO_REMOTE_INTEGRATIONS

config BR2_PACKAGE_YIO_INTEGRATION_BANGOLUFSEN
	bool "Bang & Olufsen integration"
	default y
	help
	  Includes the YIO Bang & Olufsen integration plugin.
	  https://github.com/YIO-Remote/integration.bangolufsen

if BR2_PACKAGE_YIO_INTEGRATION_BANGOLUFSEN

config BR2_PACKAGE_YIO_INTEGRATION_BANGOLUFSEN_CUSTOM_VERSION
	string "Custom version"
	default BR2_PACKAGE_YIO_INTEGRATION_BANGOLUFSEN_VERSION_DEF
	depends on BR2_PACKAGE_YIO_REMOTE_CUSTOM_VERSION
	help
	  Custom version. Either a GitHub tag or commit hash.
	  Set version number with 'v' prefix, e.g. v0.3.0 or v0.4.0
	  See https://github.com/YIO-Remote/integration.bangolufsen/releases
	  Attention: Git branch names are not supported!
	  See Buildroot manual for details.

config BR2_PACKAGE_YIO_INTEGRATION_BANGOLUFSEN_VERSION
	string
	default BR2_PACKAGE_YIO_INTEGRATION_BANGOLUFSEN_CUSTOM_VERSION \
		if BR2_PACKAGE_YIO_REMOTE_CUSTOM_VERSION
	default BR2_PACKAGE_YIO_INTEGRATION_BANGOLUFSEN_VERSION_DEF

endif # BR2_PACKAGE_YIO_INTEGRATION_BANGOLUFSEN

endif # BR2_PACKAGE_YIO_REMOTE_INTEGRATIONS
```

## buildroot-external/package/yio-remote/yio-integration-homey/Config.in
```kconfig
if BR2_PACKAGE_YIO_REMOTE_INTEGRATIONS

config BR2_PACKAGE_YIO_INTEGRATION_HOMEY
	bool "Homey integration"
	default y
	help
	  Includes the YIO Homey integration plugin.
	  https://github.com/YIO-Remote/integration.homey

if BR2_PACKAGE_YIO_INTEGRATION_HOMEY

config BR2_PACKAGE_YIO_INTEGRATION_HOMEY_CUSTOM_VERSION
	string "Custom version"
	default BR2_PACKAGE_YIO_INTEGRATION_HOMEY_VERSION_DEF
	depends on BR2_PACKAGE_YIO_REMOTE_CUSTOM_VERSION
	help
	  Custom version. Either a GitHub tag or commit hash.
	  Set version number with 'v' prefix, e.g. v0.3.0 or v0.4.0
	  See https://github.com/YIO-Remote/integration.homey/releases
	  Attention: Git branch names are not supported!
	  See Buildroot manual for details.

config BR2_PACKAGE_YIO_INTEGRATION_HOMEY_VERSION
	string
	default BR2_PACKAGE_YIO_INTEGRATION_HOMEY_CUSTOM_VERSION \
		if BR2_PACKAGE_YIO_REMOTE_CUSTOM_VERSION
	default BR2_PACKAGE_YIO_INTEGRATION_HOMEY_VERSION_DEF

endif # BR2_PACKAGE_YIO_INTEGRATION_HOMEY

endif # BR2_PACKAGE_YIO_REMOTE_INTEGRATIONS
```

## buildroot-external/package/yio-remote/yio-integration-openhab/Config.in
```kconfig
if BR2_PACKAGE_YIO_REMOTE_INTEGRATIONS

config BR2_PACKAGE_YIO_INTEGRATION_OPENHAB
	bool "openHAB integration (UNDER DEVELOPMENT)"
	default n
	help
	  Includes the YIO openHAB integration plugin.
	  https://github.com/YIO-Remote/integration.openhab

if BR2_PACKAGE_YIO_INTEGRATION_OPENHAB

config BR2_PACKAGE_YIO_INTEGRATION_OPENHAB_CUSTOM_VERSION
	string "Custom version"
	default BR2_PACKAGE_YIO_INTEGRATION_OPENHAB_VERSION_DEF
	depends on BR2_PACKAGE_YIO_REMOTE_CUSTOM_VERSION
	help
	  Custom version. Either a GitHub tag or commit hash.
	  Set version number with 'v' prefix, e.g. v0.3.0 or v0.4.0
	  See https://github.com/YIO-Remote/integration.openhab/releases
	  Attention: Git branch names are not supported!
	  See Buildroot manual for details.

config BR2_PACKAGE_YIO_INTEGRATION_OPENHAB_VERSION
	string
	default BR2_PACKAGE_YIO_INTEGRATION_OPENHAB_CUSTOM_VERSION \
		if BR2_PACKAGE_YIO_REMOTE_CUSTOM_VERSION
	default BR2_PACKAGE_YIO_INTEGRATION_OPENHAB_VERSION_DEF

endif # BR2_PACKAGE_YIO_INTEGRATION_OPENHAB

endif # BR2_PACKAGE_YIO_REMOTE_INTEGRATIONS
```

## buildroot-external/package/yio-remote/yio-integration-openweather/Config.in
```kconfig
if BR2_PACKAGE_YIO_REMOTE_INTEGRATIONS

config BR2_PACKAGE_YIO_INTEGRATION_OPENWEATHER
	bool "OpenWeather integration (EXPERIMENTAL!)"
	default n
	help
	  Includes the YIO OpenWeather integration plugin.
	  https://github.com/YIO-Remote/integration.openweather

if BR2_PACKAGE_YIO_INTEGRATION_OPENWEATHER

config BR2_PACKAGE_YIO_INTEGRATION_OPENWEATHER_CUSTOM_VERSION
	string "Custom version"
	default BR2_PACKAGE_YIO_INTEGRATION_OPENWEATHER_VERSION_DEF
	depends on BR2_PACKAGE_YIO_REMOTE_CUSTOM_VERSION
	help
	  Custom version. Either a GitHub tag or commit hash.
	  Set version number with 'v' prefix, e.g. v0.3.0 or v0.4.0
	  See https://github.com/YIO-Remote/integration.openweather/releases
	  Attention: Git branch names are not supported!
	  See Buildroot manual for details.

config BR2_PACKAGE_YIO_INTEGRATION_OPENWEATHER_VERSION
	string
	default BR2_PACKAGE_YIO_INTEGRATION_OPENWEATHER_CUSTOM_VERSION \
		if BR2_PACKAGE_YIO_REMOTE_CUSTOM_VERSION
	default BR2_PACKAGE_YIO_INTEGRATION_OPENWEATHER_VERSION_DEF

endif # BR2_PACKAGE_YIO_INTEGRATION_OPENWEATHER

endif # BR2_PACKAGE_YIO_REMOTE_INTEGRATIONS
```

## buildroot-external/package/yio-remote/yio-remote-software/Config.in
```kconfig
config BR2_PACKAGE_YIO_REMOTE_SOFTWARE
	bool "Remote application"
	default y
	select BR2_PACKAGE_YIO_WIRINGPI
	help
	  The main YIO remote-software application.
	  https://github.com/YIO-Remote/remote-software

config BR2_PACKAGE_YIO_REMOTE_SOFTWARE_CUSTOM_VERSION
	string "Custom version"
	default BR2_PACKAGE_YIO_REMOTE_SOFTWARE_VERSION_DEF
	depends on BR2_PACKAGE_YIO_REMOTE_CUSTOM_VERSION
	help
	  Custom version. Either a GitHub tag or commit hash.
	  Set version number with 'v' prefix, e.g. v0.3.0 or v0.4.0
	  See https://github.com/YIO-Remote/remote-software/releases
	  Attention: Git branch names are not supported!
	  See Buildroot manual for details.

config BR2_PACKAGE_YIO_REMOTE_SOFTWARE_VERSION
	string
	default BR2_PACKAGE_YIO_REMOTE_SOFTWARE_CUSTOM_VERSION \
		if BR2_PACKAGE_YIO_REMOTE_CUSTOM_VERSION
	default BR2_PACKAGE_YIO_REMOTE_SOFTWARE_VERSION_DEF
```
