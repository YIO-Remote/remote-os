## yio-remote/yio-integration-homey/Config.in
```kconfig
if BR2_PACKAGE_YIO_REMOTE_INTEGRATIONS

config BR2_PACKAGE_YIO_INTEGRATION_HOMEY
	bool "Homey integration"
	default y
	# only binary GitHub support for now
	depends on BR2_PACKAGE_YIO_REMOTE_BIN_RELEASE
	help
	  Includes the YIO Homey integration plugin.
	  https://github.com/YIO-Remote/integration.homey

if BR2_PACKAGE_YIO_INTEGRATION_HOMEY

config BR2_PACKAGE_YIO_INTEGRATION_HOMEY_CUSTOM_VERSION
	string "Custom version"
	default BR2_PACKAGE_YIO_INTEGRATION_HOMEY_VERSION_DEF
	depends on BR2_PACKAGE_YIO_REMOTE_CUSTOM_VERSION
	help
	  Custom version. Set version number with 'v' prefix,
	  e.g. v0.3.0 or v0.4.0
	  See https://github.com/YIO-Remote/integration.homey/releases

config BR2_PACKAGE_YIO_INTEGRATION_HOMEY_VERSION
	string
	default BR2_PACKAGE_YIO_INTEGRATION_HOMEY_CUSTOM_VERSION \
		if BR2_PACKAGE_YIO_REMOTE_CUSTOM_VERSION
	default BR2_PACKAGE_YIO_INTEGRATION_HOMEY_VERSION_DEF

endif # BR2_PACKAGE_YIO_INTEGRATION_HOMEY

endif # BR2_PACKAGE_YIO_REMOTE_INTEGRATIONS
```

## yio-remote/yio-integration-openhab/Config.in
```kconfig
if BR2_PACKAGE_YIO_REMOTE_INTEGRATIONS

config BR2_PACKAGE_YIO_INTEGRATION_OPENHAB
	bool "openHAB integration (UNDER DEVELOPMENT)"
	default n
	# only binary GitHub support for now
	depends on BR2_PACKAGE_YIO_REMOTE_BIN_RELEASE
	help
	  Includes the YIO openHAB integration plugin.
	  https://github.com/YIO-Remote/integration.openhab

if BR2_PACKAGE_YIO_INTEGRATION_OPENHAB

config BR2_PACKAGE_YIO_INTEGRATION_OPENHAB_CUSTOM_VERSION
	string "Custom version"
	default BR2_PACKAGE_YIO_INTEGRATION_OPENHAB_VERSION_DEF
	depends on BR2_PACKAGE_YIO_REMOTE_CUSTOM_VERSION
	help
	  Custom version. Set version number with 'v' prefix,
	  e.g. v0.3.0 or v0.4.0
	  See https://github.com/YIO-Remote/integration.openhab/releases

config BR2_PACKAGE_YIO_INTEGRATION_OPENHAB_VERSION
	string
	default BR2_PACKAGE_YIO_INTEGRATION_OPENHAB_CUSTOM_VERSION \
		if BR2_PACKAGE_YIO_REMOTE_CUSTOM_VERSION
	default BR2_PACKAGE_YIO_INTEGRATION_OPENHAB_VERSION_DEF

endif # BR2_PACKAGE_YIO_INTEGRATION_OPENHAB

endif # BR2_PACKAGE_YIO_REMOTE_INTEGRATIONS
```

## yio-remote/yio-integration-openweather/Config.in
```kconfig
if BR2_PACKAGE_YIO_REMOTE_INTEGRATIONS

config BR2_PACKAGE_YIO_INTEGRATION_OPENWEATHER
	bool "OpenWeather integration"
	default y
	# only binary GitHub support for now
	depends on BR2_PACKAGE_YIO_REMOTE_BIN_RELEASE
	help
	  Includes the YIO OpenWeather integration plugin.
	  https://github.com/YIO-Remote/integration.openweather

if BR2_PACKAGE_YIO_INTEGRATION_OPENWEATHER

config BR2_PACKAGE_YIO_INTEGRATION_OPENWEATHER_CUSTOM_VERSION
	string "Custom version"
	default BR2_PACKAGE_YIO_INTEGRATION_OPENWEATHER_VERSION_DEF
	depends on BR2_PACKAGE_YIO_REMOTE_CUSTOM_VERSION
	help
	  Custom version. Set version number with 'v' prefix,
	  e.g. v0.3.0 or v0.4.0
	  See https://github.com/YIO-Remote/integration.openweather/releases

config BR2_PACKAGE_YIO_INTEGRATION_OPENWEATHER_VERSION
	string
	default BR2_PACKAGE_YIO_INTEGRATION_OPENWEATHER_CUSTOM_VERSION \
		if BR2_PACKAGE_YIO_REMOTE_CUSTOM_VERSION
	default BR2_PACKAGE_YIO_INTEGRATION_OPENWEATHER_VERSION_DEF

endif # BR2_PACKAGE_YIO_INTEGRATION_OPENWEATHER

endif # BR2_PACKAGE_YIO_REMOTE_INTEGRATIONS
```

## yio-remote/yio-integration-roon/Config.in
```kconfig
if BR2_PACKAGE_YIO_REMOTE_INTEGRATIONS

config BR2_PACKAGE_YIO_INTEGRATION_ROON
	bool "Roon integration (UNDER DEVELOPMENT)"
	default n
	help
	  Includes the YIO Roon integration plugin.
	  https://github.com/YIO-Remote/integration.roon

if BR2_PACKAGE_YIO_INTEGRATION_ROON

config BR2_PACKAGE_YIO_INTEGRATION_ROON_CUSTOM_VERSION
	string "Custom version"
	default BR2_PACKAGE_YIO_INTEGRATION_ROON_VERSION_DEF
	depends on BR2_PACKAGE_YIO_REMOTE_CUSTOM_VERSION
	help
	  Custom version. Either a GitHub tag or commit hash.
	  Set version number with 'v' prefix, e.g. v0.3.0 or v0.4.0
	  See https://github.com/YIO-Remote/integration.roon/releases
	  Attention: Git branch names are not supported!
	  See Buildroot manual for details.

config BR2_PACKAGE_YIO_INTEGRATION_ROON_VERSION
	string
	default BR2_PACKAGE_YIO_INTEGRATION_ROON_CUSTOM_VERSION \
		if BR2_PACKAGE_YIO_REMOTE_CUSTOM_VERSION
	default BR2_PACKAGE_YIO_INTEGRATION_ROON_VERSION_DEF

endif # BR2_PACKAGE_YIO_INTEGRATION_ROON

endif # BR2_PACKAGE_YIO_REMOTE_INTEGRATIONS
```

## yio-remote/yio-integration-spotify/Config.in
```kconfig
if BR2_PACKAGE_YIO_REMOTE_INTEGRATIONS

config BR2_PACKAGE_YIO_INTEGRATION_SPOTIFY
	bool "Spotify integration"
	default y
	help
	  Includes the YIO Spotify integration plugin.
	  https://github.com/YIO-Remote/integration.spotify

if BR2_PACKAGE_YIO_INTEGRATION_SPOTIFY

config BR2_PACKAGE_YIO_INTEGRATION_SPOTIFY_CUSTOM_VERSION
	string "Custom version"
	default BR2_PACKAGE_YIO_INTEGRATION_SPOTIFY_VERSION_DEF
	depends on BR2_PACKAGE_YIO_REMOTE_CUSTOM_VERSION
	help
	  Custom version. Either a GitHub tag or commit hash.
	  Set version number with 'v' prefix, e.g. v0.3.0 or v0.4.0
	  See https://github.com/YIO-Remote/integration.spotify/releases
	  Attention: Git branch names are not supported!
	  See Buildroot manual for details.

config BR2_PACKAGE_YIO_INTEGRATION_SPOTIFY_VERSION
	string
	default BR2_PACKAGE_YIO_INTEGRATION_SPOTIFY_CUSTOM_VERSION \
		if BR2_PACKAGE_YIO_REMOTE_CUSTOM_VERSION
	default BR2_PACKAGE_YIO_INTEGRATION_SPOTIFY_VERSION_DEF

endif # BR2_PACKAGE_YIO_INTEGRATION_SPOTIFY

endif # BR2_PACKAGE_YIO_REMOTE_INTEGRATIONS
```

## yio-remote/yio-remote-software/Config.in
```kconfig
config BR2_PACKAGE_YIO_REMOTE_SOFTWARE
	bool "Remote application"
	default y
	help
	  The main YIO remote-software application.
	  https://github.com/YIO-Remote/remote-software

config BR2_PACKAGE_YIO_REMOTE_SOFTWARE_CUSTOM_VERSION
	string "Custom version"
	default BR2_PACKAGE_YIO_REMOTE_SOFTWARE_VERSION_DEF
	depends on BR2_PACKAGE_YIO_REMOTE_CUSTOM_VERSION
	help
	  Custom version.
	  Set version number with 'v' prefix, e.g. v0.3.0 or v0.4.0
	  See https://github.com/YIO-Remote/remote-software/releases

config BR2_PACKAGE_YIO_REMOTE_SOFTWARE_VERSION
	string
	default BR2_PACKAGE_YIO_REMOTE_SOFTWARE_CUSTOM_VERSION \
		if BR2_PACKAGE_YIO_REMOTE_CUSTOM_VERSION
	default "custom-bin" if BR2_PACKAGE_YIO_REMOTE_SOFTWARE_CUSTOM_BIN_DIR
	default BR2_PACKAGE_YIO_REMOTE_SOFTWARE_VERSION_DEF
```
