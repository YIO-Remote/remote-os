## buildroot-external/package/yio-remote/yio-web-configurator/Config.in
```kconfig
config BR2_PACKAGE_YIO_WEB_CONFIGURATOR
	bool "Web configurator"
	default y
	help
	  Include YIO web-configurator.
	  https://github.com/YIO-Remote/web-configurator

if BR2_PACKAGE_YIO_WEB_CONFIGURATOR

config BR2_PACKAGE_YIO_WEB_CONFIGURATOR_CUSTOM_VERSION
	string "Custom version"
	default BR2_PACKAGE_YIO_WEB_CONFIGURATOR_VERSION_DEF
	depends on BR2_PACKAGE_YIO_REMOTE_CUSTOM_VERSION
	help
	  Custom version. Set version number with 'v' prefix,
	  e.g. v0.3.0 or v0.4.0
	  See https://github.com/YIO-Remote/web-configurator/releases
	  This can also be a git tag or a sha1 commit hash.
	  Attention: Git branch names are not supported!
	  See Buildroot manual for details.

config BR2_PACKAGE_YIO_WEB_CONFIGURATOR_VERSION
	string
	default BR2_PACKAGE_YIO_WEB_CONFIGURATOR_CUSTOM_VERSION \
		if BR2_PACKAGE_YIO_REMOTE_CUSTOM_VERSION
	default BR2_PACKAGE_YIO_WEB_CONFIGURATOR_VERSION_DEF

endif # BR2_PACKAGE_YIO_WEB_CONFIGURATOR
```

## buildroot-external/package/yio-wiringpi/Config.in
```kconfig
config BR2_PACKAGE_YIO_WIRINGPI
	bool "WiringPi"
	depends on !BR2_STATIC_LIBS
	depends on BR2_USE_MMU # fork()
	depends on BR2_TOOLCHAIN_HAS_THREADS
    help
      Legacy wiringPi libraries (and gpio command).
      Taken from Buildroot 2020.02.6 and adapted to unofficial
      https://github.com/WiringPi/WiringPi mirror.

comment "wiringpi needs a toolchain w/ threads, dynamic library"
	depends on BR2_USE_MMU
	depends on BR2_STATIC_LIBS || !BR2_TOOLCHAIN_HAS_THREADS
```

## package/qtmqtt/Config.in
```kconfig
config BR2_PACKAGE_QTMQTT
	bool "Qt MQTT library"
	depends on BR2_PACKAGE_QT5
	select BR2_PACKAGE_QT5BASE
	help
	  Qt Module to implement MQTT protocol version 3.1 and 3.1.1
	  https://doc.qt.io/QtMQTT/index.html
```

## package/yio-remote/yio-integrations-library/Config.in
```kconfig
config BR2_PACKAGE_YIO_INTEGRATIONS_LIBRARY
	bool "Integration library"
	default y
	help
	  Includes the YIO integrations library.
	  https://github.com/YIO-Remote/integrations.library

if BR2_PACKAGE_YIO_INTEGRATIONS_LIBRARY

config BR2_PACKAGE_YIO_INTEGRATIONS_LIBRARY_CUSTOM_VERSION
	string "Custom version"
	default BR2_PACKAGE_YIO_INTEGRATIONS_LIBRARY_VERSION_DEF
	depends on BR2_PACKAGE_YIO_REMOTE_CUSTOM_VERSION
	help
	  Custom version. Either a GitHub tag or commit hash.
	  Set version number with 'v' prefix, e.g. v0.3.0 or v0.4.0
	  See https://github.com/YIO-Remote/integrations.library/releases
	  Attention: Git branch names are not supported!
	  See Buildroot manual for details.

config BR2_PACKAGE_YIO_INTEGRATIONS_LIBRARY_VERSION
	string
	default BR2_PACKAGE_YIO_INTEGRATIONS_LIBRARY_CUSTOM_VERSION \
		if BR2_PACKAGE_YIO_REMOTE_CUSTOM_VERSION
	default BR2_PACKAGE_YIO_INTEGRATIONS_LIBRARY_VERSION_DEF

endif # BR2_PACKAGE_YIO_INTEGRATIONS_LIBRARY
```

## rpi0/defconfig
```kconfig
BR2_arm=y
BR2_arm1176jzf_s=y
BR2_DL_DIR="$(HOME)/buildroot/dl"
BR2_GNU_MIRROR="http://ftp.thunix.net/gnu-ftp"
BR2_CCACHE=y
BR2_CCACHE_DIR="$(HOME)/buildroot/ccache"
BR2_PACKAGE_OVERRIDE_FILE="$(BR2_EXTERNAL_BUILDROOT_SUBMODULE_PATH)/local.mk"
BR2_GLOBAL_PATCH_DIR="$(BR2_EXTERNAL_BUILDROOT_SUBMODULE_PATH)/patch"
BR2_TOOLCHAIN_BUILDROOT_GLIBC=y
BR2_PACKAGE_HOST_LINUX_HEADERS_CUSTOM_4_14=y
BR2_TOOLCHAIN_BUILDROOT_CXX=y
BR2_TARGET_GENERIC_HOSTNAME="yioremote"
BR2_TARGET_GENERIC_ISSUE="Welcome to YIO Remote"
BR2_INIT_SYSTEMD=y
BR2_TARGET_GENERIC_ROOT_PASSWD="yioremote"
BR2_GENERATE_LOCALE="en_US.UTF-8"
BR2_TARGET_LOCALTIME="Europe/Copenhagen"
BR2_ROOTFS_OVERLAY="$(BR2_EXTERNAL_BUILDROOT_SUBMODULE_PATH)/overlay"
BR2_ROOTFS_POST_BUILD_SCRIPT="$(BR2_EXTERNAL_BUILDROOT_SUBMODULE_PATH)/$(PROJECT_NAME)/post-build.sh"
BR2_ROOTFS_POST_IMAGE_SCRIPT="$(BR2_EXTERNAL_BUILDROOT_SUBMODULE_PATH)/$(PROJECT_NAME)/post-image.sh"
BR2_LINUX_KERNEL=y
BR2_LINUX_KERNEL_CUSTOM_TARBALL=y
BR2_LINUX_KERNEL_CUSTOM_TARBALL_LOCATION="https://github.com/raspberrypi/linux/archive/raspberrypi-kernel_1.20190401-1.tar.gz"
BR2_LINUX_KERNEL_USE_CUSTOM_CONFIG=y
BR2_LINUX_KERNEL_CUSTOM_CONFIG_FILE="$(BR2_EXTERNAL_BUILDROOT_SUBMODULE_PATH)/$(PROJECT_NAME)/kernel_config"
BR2_LINUX_KERNEL_LZO=y
BR2_LINUX_KERNEL_DTS_SUPPORT=y
BR2_LINUX_KERNEL_INTREE_DTS_NAME="bcm2708-rpi-0-w"
BR2_PACKAGE_FFMPEG=y
BR2_PACKAGE_FBV=y
BR2_PACKAGE_QT5=y
BR2_PACKAGE_QT5BASE_DEFAULT_QPA="eglfs"
BR2_PACKAGE_RPI_BT_FIRMWARE=y
BR2_PACKAGE_RPI_FIRMWARE=y
BR2_PACKAGE_RPI_FIRMWARE_INSTALL_VCDBG=y
BR2_PACKAGE_RPI_WIFI_FIRMWARE=y
BR2_PACKAGE_DBUS_CPP=y
BR2_PACKAGE_I2C_TOOLS=y
BR2_PACKAGE_RNG_TOOLS=y
BR2_PACKAGE_NODEJS=y
BR2_PACKAGE_PHP=y
BR2_PACKAGE_PHP_EXT_FILEINFO=y
BR2_PACKAGE_PHP_EXT_ZIP=y
BR2_PACKAGE_PHP_EXT_JSON=y
BR2_PACKAGE_PHP_EXT_CURL=y
BR2_PACKAGE_PHP_EXT_SOCKETS=y
BR2_PACKAGE_OPUS=y
BR2_PACKAGE_CA_CERTIFICATES=y
BR2_PACKAGE_GNUTLS=y
BR2_PACKAGE_LIBNSS=y
BR2_PACKAGE_OPENSSL=y
BR2_PACKAGE_LIBOPENSSL_ENGINES=y
BR2_PACKAGE_LIBDRM=y
BR2_PACKAGE_TIFF=y
BR2_PACKAGE_WEBP=y
BR2_PACKAGE_WEBP_DEMUX=y
BR2_PACKAGE_WIRINGPI=y
BR2_PACKAGE_LIBXML2=y
BR2_PACKAGE_LIBVPX=y
BR2_PACKAGE_GLIB_NETWORKING=y
BR2_PACKAGE_LIBCGI=y
BR2_PACKAGE_CURL=y
BR2_PACKAGE_LIBCURL_GNUTLS=y
BR2_PACKAGE_LIBEVDEV=y
BR2_PACKAGE_AVAHI=y
# BR2_PACKAGE_AVAHI_AUTOIPD is not set
BR2_PACKAGE_AVAHI_DAEMON=y
BR2_PACKAGE_AVAHI_LIBDNSSD_COMPATIBILITY=y
BR2_PACKAGE_BIND=y
BR2_PACKAGE_BLUEZ_TOOLS=y
BR2_PACKAGE_BLUEZ5_UTILS=y
BR2_PACKAGE_BLUEZ5_UTILS_OBEX=y
BR2_PACKAGE_BLUEZ5_UTILS_CLIENT=y
BR2_PACKAGE_BLUEZ5_UTILS_DEPRECATED=y
BR2_PACKAGE_BLUEZ5_UTILS_EXPERIMENTAL=y
BR2_PACKAGE_BLUEZ5_UTILS_PLUGINS_HEALTH=y
BR2_PACKAGE_BLUEZ5_UTILS_PLUGINS_MIDI=y
BR2_PACKAGE_BLUEZ5_UTILS_PLUGINS_NFC=y
BR2_PACKAGE_BLUEZ5_UTILS_PLUGINS_SAP=y
BR2_PACKAGE_BLUEZ5_UTILS_PLUGINS_SIXAXIS=y
BR2_PACKAGE_BLUEZ5_UTILS_TEST=y
BR2_PACKAGE_DHCPCD=y
BR2_PACKAGE_DNSMASQ=y
# BR2_PACKAGE_DNSMASQ_TFTP is not set
BR2_PACKAGE_DROPBEAR=y
BR2_PACKAGE_FCGIWRAP=y
BR2_PACKAGE_GESFTPSERVER=y
BR2_PACKAGE_HOSTAPD=y
BR2_PACKAGE_HOSTAPD_EAP=y
# BR2_PACKAGE_HOSTAPD_VLAN is not set
BR2_PACKAGE_IPTABLES=y
BR2_PACKAGE_IW=y
BR2_PACKAGE_LIGHTTPD=y
BR2_PACKAGE_LIGHTTPD_PCRE=y
BR2_PACKAGE_NTP=y
BR2_PACKAGE_WPA_SUPPLICANT=y
BR2_PACKAGE_WPA_SUPPLICANT_AP_SUPPORT=y
BR2_PACKAGE_WPA_SUPPLICANT_WIFI_DISPLAY=y
BR2_PACKAGE_WPA_SUPPLICANT_EAP=y
BR2_PACKAGE_WPA_SUPPLICANT_CLI=y
BR2_PACKAGE_WPA_SUPPLICANT_WPA_CLIENT_SO=y
BR2_PACKAGE_WPA_SUPPLICANT_PASSPHRASE=y
BR2_PACKAGE_BASH=y
# BR2_PACKAGE_SYSTEMD_HWDB is not set
# BR2_PACKAGE_SYSTEMD_MYHOSTNAME is not set
BR2_PACKAGE_SYSTEMD_RFKILL=y
# BR2_PACKAGE_SYSTEMD_TIMESYNCD is not set
BR2_PACKAGE_UTIL_LINUX_KILL=y
BR2_PACKAGE_UTIL_LINUX_RFKILL=y
BR2_PACKAGE_NANO=y
BR2_TARGET_ROOTFS_EXT2=y
BR2_TARGET_ROOTFS_EXT2_4=y
BR2_TARGET_ROOTFS_EXT2_SIZE="512M"
BR2_TARGET_ROOTFS_EXT2_MKFS_OPTIONS="-O 64bit"
# BR2_TARGET_ROOTFS_TAR is not set
BR2_PACKAGE_HOST_DOSFSTOOLS=y
BR2_PACKAGE_HOST_GENIMAGE=y
BR2_PACKAGE_HOST_MTOOLS=y
BR2_PACKAGE_YIO_REMOTE=y
```

## yio-remote/Config.in
```kconfig
menuconfig BR2_PACKAGE_YIO_REMOTE
	bool "YIO remote"
	depends on BR2_PACKAGE_QT5
	select BR2_PACKAGE_QT5TOOLS
	select BR2_PACKAGE_QT5TOOLS_LINGUIST_TOOLS
	select BR2_PACKAGE_QT5BASE_OPENGL_LIB
	select BR2_PACKAGE_QT5BASE_EGLFS
	select BR2_PACKAGE_QT5BASE_FONTCONFIG
	select BR2_PACKAGE_QT5BASE_GIF
	select BR2_PACKAGE_QT5BASE_JPEG
	select BR2_PACKAGE_QT5BASE_PNG
	select BR2_PACKAGE_QT5BASE_ICU
	select BR2_PACKAGE_QT5BASE_TSLIB
	select BR2_PACKAGE_QT5CONNECTIVITY
	select BR2_PACKAGE_QT5GRAPHICALEFFECTS
	select BR2_PACKAGE_QT5IMAGEFORMATS
	select BR2_PACKAGE_QT5QUICKCONTROLS
	select BR2_PACKAGE_QT5QUICKCONTROLS2
	select BR2_PACKAGE_QT5VIRTUALKEYBOARD
	select BR2_PACKAGE_QT5VIRTUALKEYBOARD_HANDWRITING
	select BR2_PACKAGE_QT5WEBSOCKETS
	help
	  YIO Remote software package. Sub-options allow to customize the
	  installation.
	  For more information see: https://github.com/YIO-Remote

if BR2_PACKAGE_YIO_REMOTE

# Default versions of all YIO components which work together in this remote-os release.
# All YIO components have their own release channel and version numbers don't relate or indicate a compatible version!
# Custom versions can be enabled with: BR2_PACKAGE_YIO_REMOTE_CUSTOM_VERSION
config BR2_PACKAGE_YIO_REMOTE_SOFTWARE_VERSION_DEF
	string
	default "v0.5.3"
config BR2_PACKAGE_YIO_WEB_CONFIGURATOR_VERSION_DEF
	string
	default "v0.2.1"
config BR2_PACKAGE_YIO_INTEGRATION_DOCK_VERSION_DEF
	string
	default "v0.6.1"
config BR2_PACKAGE_YIO_INTEGRATION_HOMEASSISTANT_VERSION_DEF
	string
	default "v0.5.3"
config BR2_PACKAGE_YIO_INTEGRATION_HOMEY_VERSION_DEF
	string
	default "v0.5.1"
config BR2_PACKAGE_YIO_INTEGRATION_OPENHAB_VERSION_DEF
	string
	default "v0.5.1"
config BR2_PACKAGE_YIO_INTEGRATION_SPOTIFY_VERSION_DEF
	string
	default "v0.5.1"
config BR2_PACKAGE_YIO_INTEGRATION_BANGOLUFSEN_VERSION_DEF
	string
	default "v0.2.2"
config BR2_PACKAGE_YIO_INTEGRATION_OPENWEATHER_VERSION_DEF
	string
	default "v0.5.1"
config BR2_PACKAGE_YIO_INTEGRATION_ROON_VERSION_DEF
	string
	default "v0.4.1"

choice
	prompt "Source"
	help
	  Select from where the YIO remote components will be installed.
	  This only applies to Qt based components, i.e. the web-configurator
	  will always be packaged from the GitHub sources.

config BR2_PACKAGE_YIO_REMOTE_BIN_RELEASE
	bool "Binary GitHub releases"
	help
	  Use binary releases for Qt based components from GitHub repositories.
	  Attention: the binary releases are only compatible on the Raspberry Pi!

config BR2_PACKAGE_YIO_REMOTE_CUSTOM_BIN_DIR
	bool "Binary folder"
	help
	  This option allows to specify a local folder containing pre-compiled
	  Qt binaries for the target platform. The folder must contain debug and
	  release subdirectories.
	  Attention: Buildroot will cache the synchronized folder after the first
	  build. To update the binaries all involved packages must be reconfigured
	  by executing:
	  make yio-${PACKAGE_NAME}-reconfigure
	  or the build directories of all yio packages must be deleted:
	  rm -Rf rpi0/output/build/yio-*
	  before building a new image!

# TODO Build from source not yet implemented
# config BR2_PACKAGE_YIO_REMOTE_GITHUB
# 	bool "Build from source"
# 	help
# 	  Use GitHub source repositories to build YIO components.

endchoice

config BR2_PACKAGE_YIO_REMOTE_CUSTOM_BIN_DIR_LOCATION
	string "URL of custom app binary folder"
	default "~/projects/yio/binaries/linux-gcc-arm"
	depends on BR2_PACKAGE_YIO_REMOTE_CUSTOM_BIN_DIR
	help
	  Local folder containing pre-compiled binaries for the target platform.
	  The folder must contain debug and release subdirectories.
	  Attention: Buildroot will cache the synchronized folder after the first
	  build. To update the binaries all involved packages must be reconfigured
	  by executing:
	  make yio-${PACKAGE_NAME}-reconfigure
	  or the build directories of all yio packages must be deleted:
	  rm -Rf rpi0/output/build/yio-*
	  before building a new image!

config BR2_PACKAGE_YIO_REMOTE_DEBUG
	bool "Debug build"
	help
	  Build or install the debug version of the Qt based YIO application and
	  integration plugins.
	  Attention: Buildroot will cache the build folder after the first build.
	  To switch between debug an release builds afterwards, all involved
	  packages must be reconfigured by executing:
	  make yio-${PACKAGE_NAME}-reconfigure
	  or the build directories of all yio packages must be deleted:
	  rm -Rf rpi0/output/build/yio-*
	  before building a new image!

config BR2_PACKAGE_YIO_REMOTE_CUSTOM_VERSION
	bool "Custom versions (DANGEROUS!)"
	help
	  Allow to specify custom versions of the application and integration
	  plugins.
	  Attention: using custom versions might break compatability between the
	  remote application and the integration plugins!

source "../yio-remote/yio-remote-software/Config.in"
source "../yio-remote/yio-web-configurator/Config.in"

config BR2_PACKAGE_YIO_REMOTE_INTEGRATIONS
	bool "Integration plugins"
	default y
	help
	  Include YIO integration plugins.

source "../yio-remote/yio-integration-dock/Config.in"
source "../yio-remote/yio-integration-homeassistant/Config.in"
source "../yio-remote/yio-integration-homey/Config.in"
source "../yio-remote/yio-integration-spotify/Config.in"
source "../yio-remote/yio-integration-bangolufsen/Config.in"
source "../yio-remote/yio-integration-openhab/Config.in"
source "../yio-remote/yio-integration-roon/Config.in"
source "../yio-remote/yio-integration-openweather/Config.in"

endif
```

## yio-remote/yio-integration-bangolufsen/Config.in
```kconfig
if BR2_PACKAGE_YIO_REMOTE_INTEGRATIONS

config BR2_PACKAGE_YIO_INTEGRATION_BANGOLUFSEN
	bool "Bang & Olufsen integration"
	default y
	# only binary GitHub support for now
	depends on BR2_PACKAGE_YIO_REMOTE_BIN_RELEASE
	help
	  Includes the YIO Bang & Olufsen integration plugin.
	  https://github.com/YIO-Remote/integration.bangolufsen

if BR2_PACKAGE_YIO_INTEGRATION_BANGOLUFSEN

config BR2_PACKAGE_YIO_INTEGRATION_BANGOLUFSEN_CUSTOM_VERSION
	string "Custom version"
	default BR2_PACKAGE_YIO_INTEGRATION_BANGOLUFSEN_VERSION_DEF
	depends on BR2_PACKAGE_YIO_REMOTE_CUSTOM_VERSION
	help
	  Custom version. Set version number with 'v' prefix,
	  e.g. v0.3.0 or v0.4.0
	  See https://github.com/YIO-Remote/integration.bangolufsen/releases

config BR2_PACKAGE_YIO_INTEGRATION_BANGOLUFSEN_VERSION
	string
	default BR2_PACKAGE_YIO_INTEGRATION_BANGOLUFSEN_CUSTOM_VERSION \
		if BR2_PACKAGE_YIO_REMOTE_CUSTOM_VERSION
	default BR2_PACKAGE_YIO_INTEGRATION_BANGOLUFSEN_VERSION_DEF

endif # BR2_PACKAGE_YIO_INTEGRATION_BANGOLUFSEN

endif # BR2_PACKAGE_YIO_REMOTE_INTEGRATIONS
```

## yio-remote/yio-integration-dock/Config.in
```kconfig
if BR2_PACKAGE_YIO_REMOTE_INTEGRATIONS

config BR2_PACKAGE_YIO_INTEGRATION_DOCK
	bool "Dock integration"
	default y
	help
	  Includes the YIO dock integration plugin.
	  https://github.com/YIO-Remote/integration.dock

if BR2_PACKAGE_YIO_INTEGRATION_DOCK

config BR2_PACKAGE_YIO_INTEGRATION_DOCK_CUSTOM_VERSION
	string "Custom version"
	default BR2_PACKAGE_YIO_INTEGRATION_DOCK_VERSION_DEF
	depends on BR2_PACKAGE_YIO_REMOTE_CUSTOM_VERSION
	help
	  Custom version. Either a GitHub tag or commit hash.
	  Set version number with 'v' prefix, e.g. v0.3.0 or v0.4.0
	  See https://github.com/YIO-Remote/integration.dock/releases
	  Attention: Git branch names are not supported!
	  See Buildroot manual for details.

config BR2_PACKAGE_YIO_INTEGRATION_DOCK_VERSION
	string
	default BR2_PACKAGE_YIO_INTEGRATION_DOCK_CUSTOM_VERSION \
		if BR2_PACKAGE_YIO_REMOTE_CUSTOM_VERSION
	default BR2_PACKAGE_YIO_INTEGRATION_DOCK_VERSION_DEF

endif # BR2_PACKAGE_YIO_INTEGRATION_DOCK

endif # BR2_PACKAGE_YIO_REMOTE_INTEGRATIONS
```

## yio-remote/yio-integration-homeassistant/Config.in
```kconfig
if BR2_PACKAGE_YIO_REMOTE_INTEGRATIONS

config BR2_PACKAGE_YIO_INTEGRATION_HOMEASSISTANT
	bool "Home Assistant integration"
	default y
	help
	  Includes the YIO Home Assistant integration plugin.
	  https://github.com/YIO-Remote/integration.home-assistant

if BR2_PACKAGE_YIO_INTEGRATION_HOMEASSISTANT

config BR2_PACKAGE_YIO_INTEGRATION_HOMEASSISTANT_CUSTOM_VERSION
	string "Custom version"
	default BR2_PACKAGE_YIO_INTEGRATION_HOMEASSISTANT_VERSION_DEF
	depends on BR2_PACKAGE_YIO_REMOTE_CUSTOM_VERSION
	help
	  Custom version. Either a GitHub tag or commit hash.
	  Set version number with 'v' prefix, e.g. v0.3.0 or v0.4.0
	  See https://github.com/YIO-Remote/integration.home-assistant/releases
	  Attention: Git branch names are not supported!
	  See Buildroot manual for details.

config BR2_PACKAGE_YIO_INTEGRATION_HOMEASSISTANT_VERSION
	string
	default BR2_PACKAGE_YIO_INTEGRATION_HOMEASSISTANT_CUSTOM_VERSION \
		if BR2_PACKAGE_YIO_REMOTE_CUSTOM_VERSION
	default BR2_PACKAGE_YIO_INTEGRATION_HOMEASSISTANT_VERSION_DEF

endif # BR2_PACKAGE_YIO_INTEGRATION_HOMEASSISTANT

endif # BR2_PACKAGE_YIO_REMOTE_INTEGRATIONS
```
